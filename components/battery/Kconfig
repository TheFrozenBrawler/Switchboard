## components/battery/Kconfig
```kconfig
menu "Battery task config"
    config BATTERY_TASK_STACK_SIZE
        int "Battery task stack size"
        default 4096
        help
            Set battery task stack size

    config BATTERY_TASK_CORE
        int "Battery task thread core"
        default 1
        help
            Set battery task thread core
endmenu

menu "Battery config"
    choice
        bool "Choose battery type"
        default BATTERY_3V3
        config BATTERY_3V3
            bool "Battery 3.3V"
        config BATTERY_12V_1
            bool "Battery 12V nb. 1"
        config BATTERY_12V_2
            bool "Battery 12V nb. 2"
    endchoice

    config BATTERY_LOGGER_EN
        bool "Battery manager Logger enable"
        default y if ENV_DEBUG
        default n
        help
            Choose if show logs from Battery Task

    config VOLTAGE_DIVIDER_R1
        int "Voltage divider R1"
        default 1000000
        help
            Voltage divider R1 value in Ohms

    config VOLTAGE_DIVIDER_R2
        int "Voltage divider R2"
        default 249000
        help
            Voltage divider R2 value in Ohms

    config BATTERY_TIMER_TIME
        int "Measure timer callback time (seconds)"
        default 5
        help
            Battery measure timer callback time in seconds

    config BATTERY_MEASUREMENT_PIN
        int "Battery measurement pin"
        range 4 6
        help
            IO number of battery measurement pin
            - 4 for 3V3
            - 5 for 12V_1
            - 6 for 12V_2
endmenu

menu "CPU temperature sensor config"
    config CPU_TEMP_LOGGER_EN
        bool "CPU temperature Logger enable"
        default y if ENV_DEBUG
        default n
        help
            Choose if show logs from CPU temperature component

    config CPU_T_MIN
        int "Minimal sensed CPU temperature (MANUAL)"
        default(-10)
        help
            Check manual for correct value!

    config CPU_T_MAX
        int "Maximal sensed CPU temperature (MANUAL)"
        default(80)
        help
            Check manual for correct value!
endmenu
```

## components/event_manager/Kconfig
```kconfig
menu "Event manager"
    config EVENT_LOGGER_EN
        bool "Event manager Logger enable"
        default y if ENV_DEBUG
        default n
        help
            Choose if show logs from Event Manager
endmenu
```

## components/global/Kconfig
```kconfig
menu "Common config"
    config PRIORITY_LOW
        int "PRIORITY_LOW level config"
        default 1
        help
            Set PRIORITY_LOW level

    config PRIORITY_NORMAL
        int "PRIORITY_NORMAL level config"
        default 2
        help
            Set PRIORITY_NORMAL level

    config PRIORITY_HIGH
        int "PRIORITY_HIGH level config"
        default 3
        help
            Set PRIORITY_HIGH level

endmenu
```

## components/message_task/Kconfig
```kconfig
menu "Message task config"
    config MESSAGE_LOGGER_EN
        bool "Message Manager Logger enable"
        default y if ENV_DEBUG
        default n
        help
            Choose if show logs from Message Manager

    config MESSAGE_TASK_STACK_SIZE
        int "MESSAGE task stack size"
        default 4096
        help
            Set message task stack size

    config MESSAGE_TASK_CORE
        int "Message task core"
        default 1
        help
            Set message task core
endmenu
```

## components/mqtt_task/Kconfig
```kconfig
menu "MQTT task config"
    config MQTT_TASK_STACK_SIZE
        int "MQTT task stack size"
        default 4096
        help
            Set MQTT task stack size

    config MQTT_TASK_CORE
        int "MQTT task thread core"
        default 0
        help
            Set MQTT task thread core
endmenu

menu "MQTT config"
    choice
        bool "Select MQTT mode"
        default MQTT_RELEASE
        config MQTT_RELEASE
            bool "MQTT release"
        config MQTT_DEBUG
            bool "MQTT debug"
    endchoice

    config MQTT_LOGGER_EN
        bool "MQTT Task Logger enable"
        default y if ENV_DEBUG
        default n
        help
            Choose if show logs from MQTT Task

    menu "Release MQTT config"
        depends on MQTT_RELEASE

        config MQTT_RELEASE_SERVER_IP
            string "MQTT release server IP"
            default ""
            help
                Set MQTT release server IP

        config MQTT_RELEASE_CLIEND_ID
            depends on SWITCHBOARD_NB_1
            string "MQTT release client ID"
            default "switchboard-1"
            help
                set MQTT release client ID

        config MQTT_RELEASE_CLIEND_ID
            depends on SWITCHBOARD_NB_2
            string "MQTT release client ID"
            default "switchboard-2"
            help
                set MQTT release client ID

        config MQTT_RELEASE_PORT
            string "MQTT release port"
            default "1883"
            help
                set MQTT release server port

        config MQTT_RELEASE_TOPIC
            string "MQTT release topic"
            default "SwitchBoardMsgOut"
            help
                set MQTT release topic

        config MQTT_RELEASE_RECON_TIMEOUT
            int "MQTT release reconnection timeout in miliseconds"
            default 1000
            help
                set MQTT reconnection timeout in miliseconds
    endmenu

    menu "Debug MQTT config"
        depends on MQTT_DEBUG

        config MQTT_DEBUG_SERVER_IP
            string "MQTT debug server IP"
            default ""
            help
                Set MQTT debug server IP

        config MQTT_DEBUG_CLIEND_ID
            depends on SWITCHBOARD_NB_1
            string "MQTT debug client ID"
            default "switchboard-1"
            help
                Set MQTT debug client ID

        config MQTT_DEBUG_CLIEND_ID
            depends on SWITCHBOARD_NB_2
            string "MQTT debug client ID"
            default "switchboard-2"
            help
                set MQTT debug client ID

        config MQTT_DEBUG_PORT
            string "MQTT debug port"
            default "1883"
            help
                set MQTT debug server port

        config MQTT_DEBUG_TOPIC
            string "MQTT debug topic"
            default "SwitchBoardMsgOut"
            help
                set MQTT debug topic

        config MQTT_DEBUG_RECON_TIMEOUT
            int "MQTT debug reconnection timeout in miliseconds"
            default 1000
            help
                set MQTT reconnection timeout in miliseconds

    endmenu
endmenu
```

## components/switch_task/Kconfig
```kconfig
menu "Switch task config"
    config SWITCH_TASK_STACK_SIZE
        int "SWITCH task stack size"
        default 4096
        help
            Set switch task stack size

    config SWITCH_TASK_CORE
        int "MQTT task thread core"
        default 1
        help
            Set switch task thread core
endmenu

menu "Switch config"
    config SWITCH_LOGGER_EN
        bool "Switch Task Logger enable"
        default y if ENV_DEBUG
        default n
        help
            Choose if show logs from Switch Task

    config DEBOUNCING_TIME
        int "Switch debouncing time in miliseconds"
        default 50
        help
            Set switch debouncing time in miliseconds
endmenu

menu "Switches MQTT & LED bit config"
    config SWITCH_0_MQTT_BIT
        int "Switch 0 MQTT bit"
        default 10

    config SWITCH_0_LED_BIT
        int "Switch 0 LED bit"
        default 10


    config SWITCH_1_MQTT_BIT
        int "Switch 1 MQTT bit"
        default 11

    config SWITCH_1_LED_BIT
        int "Switch 1 LED bit"
        default 11


    config SWITCH_2_MQTT_BIT
        int "Switch 2 MQTT bit"
        default 8

    config SWITCH_2_LED_BIT
        int "Switch 2 LED bit"
        default 8


    config SWITCH_3_MQTT_BIT
        int "Switch 3 MQTT bit"
        default 9

    config SWITCH_3_LED_BIT
        int "Switch 3 LED bit"
        default 9


    config SWITCH_4_MQTT_BIT
        int "Switch 4 MQTT bit"
        default 6

    config SWITCH_4_LED_BIT
        int "Switch 4 LED bit"
        default 6


    config SWITCH_5_MQTT_BIT
        int "Switch 5 MQTT bit"
        default 7

    config SWITCH_5_LED_BIT
        int "Switch 5 LED bit"
        default 7


    config SWITCH_6_MQTT_BIT
        int "Switch 6 MQTT bit"
        default 2

    config SWITCH_6_LED_BIT
        int "Switch 6 LED bit"
        default 2


    config SWITCH_7_MQTT_BIT
        int "Switch 7 MQTT bit"
        default 3

    config SWITCH_7_LED_BIT
        int "Switch 7 LED bit"
        default 3


    config SWITCH_8_MQTT_BIT
        int "Switch 8 MQTT bit"
        default 5

    config SWITCH_8_LED_BIT
        int "Switch 8 LED bit"
        default 5


    config SWITCH_9_MQTT_BIT
        int "Switch 9 MQTT bit"
        default 4

    config SWITCH_9_LED_BIT
        int "Switch 9 LED bit"
        default 4


    config SWITCH_10_MQTT_BIT
        int "Switch 10 MQTT bit"
        default 1

    config SWITCH_10_LED_BIT
        int "Switch 10 LED bit"
        default 1


    config SWITCH_11_MQTT_BIT
        int "Switch 11 MQTT bit"
        default 0

    config SWITCH_11_LED_BIT
        int "Switch 11 LED bit"
        default 0

endmenu
```

## components/ui_task/Kconfig
```kconfig
menu "UI task config"
    config UI_TASK_STACK_SIZE
        int "UI task stack size"
        default 4096
        help
            Set UI task stack size

    config UI_TASK_CORE
        int "UI task thread core"
        default 1
        help
            Set UI task thread core
endmenu

menu "UI config"
    config UI_LOGGER_EN
        bool "UI Task Logger enable"
        default y if ENV_DEBUG
        default n
        help
            Choose if show logs from UI task


    config BUZZER_PERIOD
        int "Buzzer default period timeout"
        default 1000
        help
            Set buzzer default period timeout

    config BUZZER_DUTY
        int "Buzzer default duty timeout"
        default 200
        help
            Set buzzer default duty timeout


    config BUZZER_SIGNAL_FAILURE_PERIOD
        int "Buzzer default period timeout"
        default 1500
        help
            Set buzzer default period timeout

    config BUZZER_SIGNAL_FAILURE_DUTY
        int "Buzzer default duty timeout"
        default 1000
        help
            Set buzzer default duty timeout


    config LED_STRIP_PIN
        int "LED strip pin"
        default 7
        help
            Set LED strip pin

    menu "LED ON color"
        config ON_COLOR_RED
            int "LED strip ready color R"
            default 0

        config ON_COLOR_GREEN
            int "LED strip ready color G"
            default 155

        config ON_COLOR_BLUE
            int "LED strip ready color B"
            default 0
    endmenu

    menu "LED OFF color"
        config OFF_COLOR_RED
            int "LED strip ready color R"
            default 255

        config OFF_COLOR_GREEN
            int "LED strip ready color G"
            default 0

        config OFF_COLOR_BLUE
            int "LED strip ready color B"
            default 0
    endmenu

endmenu
```

## components/wifi_task/Kconfig
```kconfig
menu "WIFI task config"
    config WIFI_TASK_STACK_SIZE
        int "WIFI task stack size"
        default 6144
        help
            Set WiFi task stack size

    config WIFI_TASK_CORE
        int "WiFi task core"
        default 0
        help
            Set WiFi task thread core
endmenu

menu "WiFi config"
    choice
        bool "select WiFi mode"
        default WIFI_RELEASE
        config WIFI_RELEASE
            bool "WiFi Release"
        config WIFI_DEBUG
            bool "WiFi Debug"
    endchoice

    config WIFI_LOGGER_EN
        bool "Wifi Task Logger enable"
        default y if ENV_DEBUG
        default n
        help
            Choose if show logs from Wifi Task

    menu "NTP config"
        config NTP_SERVER_ADDR
            string "Set NTP server address"
            default ""
            help
                Set NTP server addres i get NTP time

        config NTP_TIME_ZONE
            string  "Set NTP Time Zone (leave UTC [GMT])"
            default "GMT"
            help
                Set NTP Time Zone - leave default GMT

        config NTP_CONNECT_TIMEOUT_MS
            int "Set NTP connect timeout (MS)"
            default 1000
            help
                Set NTP Connect timeout in milliseconds
    endmenu

    menu "Release WiFi config"
        depends on WIFI_RELEASE

        config WIFI_RELEASE_SSID
            string "Release WiFi SSID"
            default ""
            help
                Set release network SSID

        config WIFI_RELEASE_PASSWORD
            string "Release WiFi password"
            default ""
            help
                Set release network password

        config WIFI_RELEASE_GATEWAY
            string "Release gateway"
            default ""
            help
                Set release network gateway

        config WIFI_RELEASE_SUBNET_MASK
            string "Release subnet mask"
            default ""
            help
                Set release network subnet mask

        config WIFI_RELEASE_IP
            depends on SWITCHBOARD_NB_1
            string "Release static ip"
            default ""
            help
                Set device static IP

        config WIFI_RELEASE_IP
            depends on SWITCHBOARD_NB_2
            string "Release static ip"
            default ""
            help
                Set device static IP

    endmenu

    menu "Debug WiFi config"
        depends on WIFI_DEBUG

        config WIFI_DEBUG_SSID
            string "Debug WiFi SSID"
            default ""
            help
                Set debug network SSID

        config WIFI_DEBUG_PASSWORD
            string "Debug WiFi password"
            default ""
            help
                Set debug network password

        config WIFI_DEBUG_GATEWAY
            string "Debug gateway"
            default ""
            help
                Set debug network gateway

        config WIFI_DEBUG_SUBNET_MASK
            string "Debug subnet mask"
            default ""
            help
                Set debug network subnet mask

        config WIFI_DEBUG_IP
            depends on SWITCHBOARD_NB_1
            string "Debug static ip"
            default ""
            help
                Set device static IP

        config WIFI_DEBUG_IP
            depends on SWITCHBOARD_NB_2
            string "Debug static ip"
            default ""
            help
                Set device static IP

    endmenu


endmenu
```

## main/Kconfig.projbuild
```kconfig
menu "Switchboard configutation"
    choice
        bool "Select Environment"
        default ENV_RELEASE

        config ENV_RELEASE
            bool "Release"

        config ENV_DEBUG
            bool "Debug"
    endchoice

    choice
        bool "Select Switchboard number"

        config  SWITCHBOARD_NB_1
            bool "Switchboard number 1"

        config  SWITCHBOARD_NB_2
            bool "Switchboard number 2"
    endchoice
endmenu
```
